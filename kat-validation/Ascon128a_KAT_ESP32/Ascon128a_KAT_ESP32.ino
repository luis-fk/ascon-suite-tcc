/*
 * Ascon128a_KAT_ESP32 -- Validacao on-device dos Known Answer Tests (KAT)
 * do Ascon-128a (variante v1.2 da competicao NIST LWC), no ESP32.
 *
 * Objetivo (Secao 3.4.1 do TCC): apos a validacao exaustiva em desktop,
 * confirmar na propria placa que a compilacao e a arquitetura (Xtensa LX,
 * little-endian) nao introduzem divergencias, usando um subconjunto
 * representativo dos vetores oficiais.
 *
 * Para cada vetor: (1) cifra e compara o resultado (ciphertext || tag) com
 * o valor esperado; (2) decifra o valor esperado e confirma a recuperacao
 * do texto claro com a tag validada.
 *
 * Os vetores foram extraidos do arquivo oficial ASCON-128a.txt; a estrutura
 * deste teste foi adaptada do exemplo Ascon128_Test da biblioteca ascon-suite
 * (Rhys Weatherley / Southern Storm Software, licenca MIT).
 */

#include <ASCON.h>
#include <string.h>

#if defined(__AVR__)
#include <avr/pgmspace.h>
#else
#undef PROGMEM
#undef memcpy_P
#define PROGMEM
#define memcpy_P(d,s,l) memcpy((d),(s),(l))
#endif

#define MAX_PT 32
#define MAX_AD 32

struct TestVector {
  const char *name;
  uint8_t key[16];
  uint8_t nonce[16];
  uint8_t ad[MAX_AD];
  size_t  adlen;
  uint8_t pt[MAX_PT];
  size_t  ptlen;
  uint8_t ct[MAX_PT + 16];   // ciphertext || tag esperados
  size_t  ctlen;
};

static const TestVector vectors[] PROGMEM = {
  {
    .name  = "PT=0 AD=0",
    .key   = {0x00, 0x01, 0x02, 0x03, 0x04, 0x05, 0x06, 0x07, 0x08, 0x09, 0x0a, 0x0b, 0x0c, 0x0d, 0x0e, 0x0f},
    .nonce = {0x00, 0x01, 0x02, 0x03, 0x04, 0x05, 0x06, 0x07, 0x08, 0x09, 0x0a, 0x0b, 0x0c, 0x0d, 0x0e, 0x0f},
    .ad    = {0}, .adlen = 0,
    .pt    = {0}, .ptlen = 0,
    .ct    = {0x7a, 0x83, 0x4e, 0x6f, 0x09, 0x21, 0x09, 0x57, 0x06, 0x7b, 0x10, 0xfd, 0x83, 0x1f, 0x00, 0x78}, .ctlen = 16
  },
  {
    .name  = "PT=0 AD=16",
    .key   = {0x00, 0x01, 0x02, 0x03, 0x04, 0x05, 0x06, 0x07, 0x08, 0x09, 0x0a, 0x0b, 0x0c, 0x0d, 0x0e, 0x0f},
    .nonce = {0x00, 0x01, 0x02, 0x03, 0x04, 0x05, 0x06, 0x07, 0x08, 0x09, 0x0a, 0x0b, 0x0c, 0x0d, 0x0e, 0x0f},
    .ad    = {0x00, 0x01, 0x02, 0x03, 0x04, 0x05, 0x06, 0x07, 0x08, 0x09, 0x0a, 0x0b, 0x0c, 0x0d, 0x0e, 0x0f}, .adlen = 16,
    .pt    = {0}, .ptlen = 0,
    .ct    = {0x56, 0xc1, 0x5e, 0xb0, 0x24, 0xde, 0x91, 0xca, 0x01, 0x65, 0x36, 0x2a, 0x49, 0xb3, 0x1e, 0xbd}, .ctlen = 16
  },
  {
    .name  = "PT=5 AD=0",
    .key   = {0x00, 0x01, 0x02, 0x03, 0x04, 0x05, 0x06, 0x07, 0x08, 0x09, 0x0a, 0x0b, 0x0c, 0x0d, 0x0e, 0x0f},
    .nonce = {0x00, 0x01, 0x02, 0x03, 0x04, 0x05, 0x06, 0x07, 0x08, 0x09, 0x0a, 0x0b, 0x0c, 0x0d, 0x0e, 0x0f},
    .ad    = {0}, .adlen = 0,
    .pt    = {0x00, 0x01, 0x02, 0x03, 0x04}, .ptlen = 5,
    .ct    = {0x6e, 0x49, 0x0c, 0xfe, 0xd5, 0xf1, 0x2c, 0x2f, 0xeb, 0x11, 0xe2, 0xf1, 0xad, 0xc2, 0x55, 0xf8, 0x8e, 0x98, 0x7c, 0x9d, 0xdc}, .ctlen = 21
  },
  {
    .name  = "PT=16 AD=0",
    .key   = {0x00, 0x01, 0x02, 0x03, 0x04, 0x05, 0x06, 0x07, 0x08, 0x09, 0x0a, 0x0b, 0x0c, 0x0d, 0x0e, 0x0f},
    .nonce = {0x00, 0x01, 0x02, 0x03, 0x04, 0x05, 0x06, 0x07, 0x08, 0x09, 0x0a, 0x0b, 0x0c, 0x0d, 0x0e, 0x0f},
    .ad    = {0}, .adlen = 0,
    .pt    = {0x00, 0x01, 0x02, 0x03, 0x04, 0x05, 0x06, 0x07, 0x08, 0x09, 0x0a, 0x0b, 0x0c, 0x0d, 0x0e, 0x0f}, .ptlen = 16,
    .ct    = {0x6e, 0x49, 0x0c, 0xfe, 0xd5, 0xb3, 0x54, 0x67, 0x67, 0x35, 0x0c, 0xd8, 0x3c, 0x4a, 0xcf, 0xbd, 0xb1, 0x0f, 0x61, 0x1b, 0x7d, 0x79, 0x27, 0x8b, 0xd8, 0x06, 0x7f, 0xc1, 0xbc, 0xdf, 0x39, 0xbe}, .ctlen = 32
  },
  {
    .name  = "PT=1 AD=1",
    .key   = {0x00, 0x01, 0x02, 0x03, 0x04, 0x05, 0x06, 0x07, 0x08, 0x09, 0x0a, 0x0b, 0x0c, 0x0d, 0x0e, 0x0f},
    .nonce = {0x00, 0x01, 0x02, 0x03, 0x04, 0x05, 0x06, 0x07, 0x08, 0x09, 0x0a, 0x0b, 0x0c, 0x0d, 0x0e, 0x0f},
    .ad    = {0x00}, .adlen = 1,
    .pt    = {0x00}, .ptlen = 1,
    .ct    = {0xe9, 0xc2, 0x81, 0x3c, 0xc8, 0xc6, 0xdd, 0x2f, 0x24, 0x5f, 0x3b, 0xb9, 0x76, 0xda, 0x56, 0x6e, 0x9d}, .ctlen = 17
  },
  {
    .name  = "PT=32 AD=32",
    .key   = {0x00, 0x01, 0x02, 0x03, 0x04, 0x05, 0x06, 0x07, 0x08, 0x09, 0x0a, 0x0b, 0x0c, 0x0d, 0x0e, 0x0f},
    .nonce = {0x00, 0x01, 0x02, 0x03, 0x04, 0x05, 0x06, 0x07, 0x08, 0x09, 0x0a, 0x0b, 0x0c, 0x0d, 0x0e, 0x0f},
    .ad    = {0x00, 0x01, 0x02, 0x03, 0x04, 0x05, 0x06, 0x07, 0x08, 0x09, 0x0a, 0x0b, 0x0c, 0x0d, 0x0e, 0x0f, 0x10, 0x11, 0x12, 0x13, 0x14, 0x15, 0x16, 0x17, 0x18, 0x19, 0x1a, 0x1b, 0x1c, 0x1d, 0x1e, 0x1f}, .adlen = 32,
    .pt    = {0x00, 0x01, 0x02, 0x03, 0x04, 0x05, 0x06, 0x07, 0x08, 0x09, 0x0a, 0x0b, 0x0c, 0x0d, 0x0e, 0x0f, 0x10, 0x11, 0x12, 0x13, 0x14, 0x15, 0x16, 0x17, 0x18, 0x19, 0x1a, 0x1b, 0x1c, 0x1d, 0x1e, 0x1f}, .ptlen = 32,
    .ct    = {0xa5, 0x52, 0x36, 0xac, 0x02, 0x0d, 0xbd, 0xa7, 0x4c, 0xe6, 0xcc, 0xd1, 0x0c,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 0x38, 0xd5}, .ctlen = 48
  }
};

#define NUM_VECTORS (sizeof(vectors) / sizeof(vectors[0]))

static TestVector tv;
static uint8_t outbuf[MAX_PT + 16];
static uint8_t ptbuf[MAX_PT];

static bool runVector(const TestVector *t)
{
  size_t clen = 0, mlen = 0;

  // (1) Cifra e compara com o (ciphertext || tag) esperado.
  ascon128a_aead_encrypt(outbuf, &clen,
                         t->pt, t->ptlen,
                         t->ad, t->adlen,
                         t->nonce, t->key);
  if (clen != t->ctlen || memcmp(outbuf, t->ct, t->ctlen) != 0)
    return false;

  // (2) Decifra o valor esperado e confirma texto claro + tag valida.
  int r = ascon128a_aead_decrypt(ptbuf, &mlen,
                                 t->ct, t->ctlen,
                                 t->ad, t->adlen,
                                 t->nonce, t->key);
  if (r < 0 || mlen != t->ptlen)
    return false;
  if (t->ptlen && memcmp(ptbuf, t->pt, t->ptlen) != 0)
    return false;

  return true;
}

void setup()
{
  Serial.begin(115200);
  delay(300);

  Serial.println();
  Serial.println("=== Ascon-128a KAT (on-device, ESP32) ===");
  Serial.print("Estado incremental (bytes): ");
  Serial.println((unsigned) sizeof(ascon128a_state_t));
  Serial.println();

  int passed = 0;
  for (size_t i = 0; i < NUM_VECTORS; i++) {
    memcpy_P(&tv, &vectors[i], sizeof(TestVector));

    Serial.print(tv.name);
    Serial.print(" ... ");

    if (runVector(&tv)) { 
      Serial.println("OK"); 
      passed++; 
    }
    else                  
      Serial.println("FALHOU");
  }

  Serial.println();
  Serial.print("Resultado: ");
  Serial.print(passed);
  Serial.print("/");
  Serial.print((int) NUM_VECTORS);
  Serial.println(" vetores passaram.");

  if (passed == (int) NUM_VECTORS)
    Serial.println(">>> TODOS OS VETORES PASSARAM NA PLACA <<<");
  else
    Serial.println(">>> FALHA: divergencia na placa <<<");
}

void loop()
{
  // O teste roda uma vez no setup(). Um loop() vazio fica em "busy-spin" no
  // ESP32: satura um nucleo da CPU e impede a tarefa ociosa de rodar, o que
  // dispara o watchdog, que inunda a Serial e trava o Monitor Serial.
  // O delay() cede o processador e elimina esse comportamento.
  delay(1000);
}
